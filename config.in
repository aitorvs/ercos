## config.in
```kconfig
mainmenu_name 'ERCOS-RT Configuration'
mainmenu_option next_comment
comment 'Target Platform Selection'
comment 'Choose a Vendor/Product combination.'
choice 'Vendor/Product' \
"ERC32/TSIM CONFIG_DEFAULTS_PLATFORM_SPARC_ERC32 \
LEON2/TSIM CONFIG_DEFAULTS_PLATFORM_SPARC_LEON2 \
LEON3/TSIM CONFIG_DEFAULTS_PLATFORM_SPARC_LEON3 \
M68332 CONFIG_DEFAULTS_PLATFORM_M68K_68332 \
DUMMY CONFIG_DEFAULTS_PLATFORM_NOARCH_NOPLATFORM \
" ERC32/TSIM

bool 'Customize Vendor/User Settings'		CONFIG_DEFAULTS_VENDOR
endmenu
```

## config/68332/config.in
```kconfig
# For a description of the syntax of this configuration file,
# see the Configure script.
#

mainmenu_name "ERC-32 Real Time Operating System (ERCOS-RT)"

define_bool CONFIG_ARCH_M68K y
define_bool CONFIG_PLATFORM_68332 y

define_int CONFIG_CLOCK_SPEED_MHZ	16

#------------------------------------------------------------------------------
# Architecture Dependent Configuration
#------------------------------------------------------------------------------

mainmenu_option next_comment
comment 'Architecture dependent Options for M68332'
int 'Stack Begin Address'		CONFIG_STACK_BEGIN_ADDRESS	0x0ffff0
endmenu

#------------------------------------------------------------------------------
# Loading Options
#------------------------------------------------------------------------------

mainmenu_option next_comment
comment 'Load Options'

choice 'Kernel Linked from RAM/ROM' \
	"RAM	CONFIG_RAMKERNEL" RAM
	
endmenu

source config/config.in
```

## config/ERC32/config.in
```kconfig
# For a description of the syntax of this configuration file,
# see the Configure script.
#

mainmenu_name "ERC-32 Real Time Operating System (ERCOS-RT)"

define_bool CONFIG_ARCH_SPARC y
define_bool CONFIG_PLATFORM_ERC32 y

define_int CONFIG_CLOCK_SPEED_MHZ	16

#------------------------------------------------------------------------------
# Architecture Dependent Configuration
#------------------------------------------------------------------------------

mainmenu_option next_comment
comment 'Architecture dependent Options'
bool 'Fast Kernel'	CONFIG_FAST_MODE
int 'Stack Begin Address (in KB)'	CONFIG_STACK_BEGIN_ADDRESS	0x02400000
bool 'Has Floating Point Unit (FPU)?'	CONFIG_HAS_FPU
endmenu

#------------------------------------------------------------------------------
# Loading Options
#------------------------------------------------------------------------------

mainmenu_option next_comment
comment 'Load Options'

choice 'Kernel Linked from RAM/ROM' \
	"RAM	CONFIG_RAMKERNEL" RAM
	
endmenu

source config/config.in
```

## config/NOPLATFORM/config.in
```kconfig
#
# For a description of the syntax of this configuration file,
# see the Configure script.
#

mainmenu_name "ERC-32 Real Time Operating System (ERCOS-RT)"

#define_bool CONFIG_ARCH_NOARCH y
#define_bool CONFIG_PLATFORM_NOPLATFORM y

define_int CONFIG_CLOCK_SPEED_MHZ	16

#------------------------------------------------------------------------------
# Architecture Dependent Configuration
#------------------------------------------------------------------------------

mainmenu_option next_comment
comment 'Architecture dependent Options'
int 'Stack Begin Address (in KB)'	CONFIG_STACK_BEGIN_ADDRESS	0x02400000
endmenu


source config/config.in
```

## config/config.in
```kconfig
#
# For a description of the syntax of this configuration file,
# see the Configure script.
#

#------------------------------------------------------------------------------
# Kernel Debugging Options
#------------------------------------------------------------------------------
mainmenu_option next_comment
comment 'Debug Options'

bool 'Debug information'	CONFIG_DEBUG
if [ "$CONFIG_DEBUG" = "y" ]; then

bool 'Activate the Multiplatform Simulation'	CONFIG_ERCOS_SIMU

if [ "$CONFIG_ERCOS_SIMU" = "y" ]; then
define_bool CONFIG_ERCOS_TRACER y
define_int CONFIG_TRACER_BUF_SIZE 0
define_int CONFIG_TRACER_NLEVELS 0
fi

if [ "$CONFIG_ERCOS_SIMU" = "n" ]; then

bool 'Activate the tracer'	CONFIG_ERCOS_TRACER


	if [ "$CONFIG_ERCOS_TRACER" = "y" ]; then

		int 'Tracer Buffer Size (in KB)'	CONFIG_TRACER_BUF_SIZE	1024

		int 'Number of levels to be traced'	CONFIG_TRACER_NLEVELS	5

		bool 'Activate the kernel trace'	CONFIG_ERCOS_KERNEL_TRACER

		if [ "$CONFIG_ERCOS_KERNEL_TRACER" = "n" ]; then
		bool 'Activate the syscall trace'	CONFIG_ERCOS_SYSCALL_TRACER
		fi

		bool 'Disable the high level trace'	CONFIG_ERCOS_KERNEL_DISABLE_HIGHTRACE

	fi

	bool 'Activate the GDB monitor'	CONFIG_GDB_MONITOR
fi

fi

endmenu

#------------------------------------------------------------------------------
# Kernel Configuration Options
#------------------------------------------------------------------------------
mainmenu_option next_comment
comment 'Kernel Configuration Options'

	int 'Number of system priorities'	CONFIG_NUMBER_OF_PRIORITIES	8
	int 'Kernel Stack Size (KB)'	CONFIG_KERNEL_STACK_SIZE	10

endmenu
#------------------------------------------------------------------------------
# Memory Management Options
#------------------------------------------------------------------------------

mainmenu_option next_comment
comment 'Memory Management'

bool 'Memory Management'	CONFIG_MM

endmenu

#------------------------------------------------------------------------------
# POSIX Options
#------------------------------------------------------------------------------

mainmenu_option next_comment
comment 'POSIX Options'

if [ "$CONFIG_ERCOS_SIMU" = "n" ]; then

	bool 'Enable the POSIX Interface'	CONFIG_ERCOS_POSIX

	if [ "$CONFIG_ERCOS_TRACER" = "y" ]; then
	bool 'Enable the POSIX trace interface'	CONFIG_ERCOS_POSIX_TRACE
	fi
fi

endmenu

#------------------------------------------------------------------------------
# EDROOM BPL Options
#------------------------------------------------------------------------------

mainmenu_option next_comment
comment 'EDROOM BPL compilation'

if [ "$CONFIG_ERCOS_SIMU" = "n" ]; then
	if [ "$CONFIG_ERCOS_POSIX" = "y" ]; then
	bool 'Compile the Prim_PP wrapper'	CONFIG_PRIM_PP
	fi
fi
endmenu

#------------------------------------------------------------------------------
# Test Compilation Options
#------------------------------------------------------------------------------

mainmenu_option next_comment
comment 'Test Bench'

if [ "$CONFIG_ERCOS_SIMU" = "n" ]; then
	if [ "$CONFIG_PRIM_PP" = "y" ]; then
		bool 'Automatic Test'	CONFIG_ERCOS_AUTOMATIC_TEST

		if [ "$CONFIG_ERCOS_AUTOMATIC_TEST" = "y" ]; then
			bool 'Resource Semaphore Test'	CONFIG_ERCOS_REC_TEST
			bool 'Pr_Send/Pr_Receive Test'	CONFIG_ERCOS_SEND_RECEIVE_TEST
			bool 'Pr_Time Test'	CONFIG_ERCOS_TIME_TEST
			bool 'Silent Resource Semaphore Test'	CONFIG_ERCOS_SIL_REC_TEST
			bool 'Priority Ceiling Resource Semaphore Test'	CONFIG_ERCOS_PRIOCEILING_TEST
			bool 'Pr_IRQManager Test'	CONFIG_ERCOS_IRQ_TEST
			bool 'Context Switch Latency Test'	CONFIG_ERCOS_CTX_TEST
			bool 'Interrupt Latency Test'	CONFIG_ERCOS_LAT_TEST
			bool 'Miscellaneous Test'	CONFIG_ERCOS_MISC_TEST
		fi
	fi
fi

endmenu

#------------------------------------------------------------------------------
# EDROOM Code
#------------------------------------------------------------------------------

mainmenu_option next_comment
comment 'EDROOM Code'

if [ "$CONFIG_ERCOS_SIMU" = "n" ]; then
	if [ "$CONFIG_PRIM_PP" = "y" ]; then
		if [ "$CONFIG_ERCOS_AUTOMATIC_TEST" = "n" ]; then
		bool 'EDROOM Code'	CONFIG_ERCOS_EDROOM_CODE
		fi
	fi

	if [ "$CONFIG_ERCOS_EDROOM_CODE" = "y" ]; then
	choice 'EDROOM Example' \
	  "HelloWorld	CONFIG_ERCOS_EDROOM_HELLOWORLD	\
	   NANOSAT		CONFIG_ERCOS_EDROOM_NANOSAT	\
	   MASTExample		CONFIG_ERCOS_EDROOM_MASTEXAMPLE	\
	   ServerConsumer	CONFIG_ERCOS_EDROOM_SERVERCONSUMER" NANOSAT
	fi
fi

endmenu
```
